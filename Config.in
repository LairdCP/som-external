## Config.in
```kconfig
menu "Laird Connectivity"

	config BR2_LRD_DEVEL_BUILD
	bool
	option env="BR2_LRD_DEVEL_BUILD"
	help
	  Developers at Laird can access the closed source repositories,
	  so they should set this flag to directly build from the closed
	  source repositories under $BR2_EXTERNAL_LRD_CLOSED_SOURCE_PATH/package.

	menu "Radio Stack"
		source "$BR2_EXTERNAL_LRD_SOM_PATH/package/lrd/lrd-radio/Config.in"
	endmenu

	menu "Packages"
		source "$BR2_EXTERNAL_LRD_SOM_PATH/package/lrd/Config.in"
	endmenu

	menu "Packages (Upstream)"
		source "$BR2_EXTERNAL_LRD_SOM_PATH/package/lrd-br/Config.in"
		source "$BR2_EXTERNAL_LRD_SOM_PATH/package/lrd-br/Config.in.host"
	endmenu

endmenu

source "$BR2_EXTERNAL_LRD_SOM_PATH/toolchain/toolchain-external-laird-arm/Config.in.options"
source "$BR2_EXTERNAL_LRD_SOM_PATH/toolchain/toolchain-external-laird-component/Config.in.options"
```

## board/wb40n_rdvk/patches/linux/wb40n_defconfig
```kconfig
CONFIG_EXPERIMENTAL=y
CONFIG_CROSS_COMPILE="arm-sdc-linux-gnueabi-"
CONFIG_LOCALVERSION="-lt2"
# CONFIG_LOCALVERSION_AUTO is not set
CONFIG_KERNEL_LZMA=y
# CONFIG_SWAP is not set
CONFIG_SYSVIPC=y
CONFIG_IKCONFIG=y
CONFIG_IKCONFIG_PROC=y
CONFIG_LOG_BUF_SHIFT=14
CONFIG_NAMESPACES=y
# CONFIG_UTS_NS is not set
# CONFIG_IPC_NS is not set
# CONFIG_USER_NS is not set
# CONFIG_PID_NS is not set
# CONFIG_NET_NS is not set
CONFIG_CC_OPTIMIZE_FOR_SIZE=y
CONFIG_SYSCTL_SYSCALL=y
CONFIG_EMBEDDED=y
# CONFIG_VM_EVENT_COUNTERS is not set
# CONFIG_COMPAT_BRK is not set
CONFIG_MODULES=y
CONFIG_MODULE_UNLOAD=y
CONFIG_MODVERSIONS=y
# CONFIG_LBDAF is not set
# CONFIG_IOSCHED_CFQ is not set
CONFIG_ARCH_AT91=y
CONFIG_ARCH_AT91SAM9G20=y
CONFIG_MACH_WB40N=y
CONFIG_AT91_PROGRAMMABLE_CLOCKS=y
CONFIG_AT91_SLOW_CLOCK=y
CONFIG_NO_HZ=y
CONFIG_HIGH_RES_TIMERS=y
CONFIG_PREEMPT=y
CONFIG_AEABI=y
# CONFIG_OABI_COMPAT is not set
CONFIG_CLEANCACHE=y
CONFIG_LEDS=y
CONFIG_LEDS_CPU=y
CONFIG_ZBOOT_ROM_TEXT=0x0
CONFIG_ZBOOT_ROM_BSS=0x0
CONFIG_CMDLINE="mem=32M console=ttyS0,115200"
CONFIG_CPU_IDLE=y
# CONFIG_CORE_DUMP_DEFAULT_ELF_HEADERS is not set
CONFIG_PM_RUNTIME=y
CONFIG_APM_EMULATION=y
CONFIG_NET=y
CONFIG_PACKET=y
CONFIG_UNIX=y
CONFIG_XFRM_USER=m
CONFIG_NET_KEY=m
CONFIG_INET=y
CONFIG_IP_MULTICAST=y
CONFIG_IP_ADVANCED_ROUTER=y
CONFIG_NET_IPIP=m
CONFIG_INET_IPCOMP=m
CONFIG_INET_XFRM_MODE_TRANSPORT=m
CONFIG_INET_XFRM_MODE_TUNNEL=m
CONFIG_INET_XFRM_MODE_BEET=m
CONFIG_INET_LRO=m
CONFIG_INET_DIAG=m
# CONFIG_IPV6 is not set
CONFIG_NETFILTER=y
CONFIG_NF_CONNTRACK=m
CONFIG_NF_CONNTRACK_FTP=m
CONFIG_NF_CONNTRACK_TFTP=m
CONFIG_NF_CT_NETLINK=m
CONFIG_NETFILTER_TPROXY=m
CONFIG_NETFILTER_XT_MATCH_CONNTRACK=m
CONFIG_NETFILTER_XT_MATCH_MAC=m
CONFIG_NETFILTER_XT_MATCH_MULTIPORT=m
CONFIG_NETFILTER_XT_MATCH_POLICY=m
CONFIG_NETFILTER_XT_MATCH_PHYSDEV=m
CONFIG_NETFILTER_XT_MATCH_STATE=m
CONFIG_NETFILTER_XT_MATCH_STRING=m
CONFIG_NF_CONNTRACK_IPV4=m
# CONFIG_NF_CONNTRACK_PROC_COMPAT is not set
CONFIG_IP_NF_IPTABLES=y
CONFIG_IP_NF_FILTER=y
CONFIG_IP_NF_TARGET_REJECT=m
CONFIG_NF_NAT=m
CONFIG_IP_NF_TARGET_MASQUERADE=m
CONFIG_IP_NF_TARGET_NETMAP=m
CONFIG_IP_NF_TARGET_REDIRECT=m
CONFIG_IP_NF_MANGLE=m
CONFIG_IP_NF_RAW=m
CONFIG_IP_NF_ARPTABLES=m
CONFIG_IP_NF_ARPFILTER=m
CONFIG_IP_NF_ARP_MANGLE=m
CONFIG_BRIDGE_NF_EBTABLES=m
CONFIG_BRIDGE_EBT_BROUTE=m
CONFIG_BRIDGE_EBT_T_FILTER=m
CONFIG_BRIDGE_EBT_T_NAT=m
CONFIG_BRIDGE_EBT_802_3=m
CONFIG_BRIDGE_EBT_AMONG=m
CONFIG_BRIDGE_EBT_ARP=m
CONFIG_BRIDGE_EBT_IP=m
CONFIG_BRIDGE_EBT_LIMIT=m
CONFIG_BRIDGE_EBT_MARK=m
CONFIG_BRIDGE_EBT_PKTTYPE=m
CONFIG_BRIDGE_EBT_STP=m
CONFIG_BRIDGE_EBT_VLAN=m
CONFIG_BRIDGE_EBT_ARPREPLY=m
CONFIG_BRIDGE_EBT_DNAT=m
CONFIG_BRIDGE_EBT_MARK_T=m
CONFIG_BRIDGE_EBT_REDIRECT=m
CONFIG_BRIDGE_EBT_SNAT=m
CONFIG_BRIDGE_EBT_ARPNAT=m
CONFIG_BRIDGE_EBT_LOG=m
CONFIG_BRIDGE_EBT_NFLOG=m
CONFIG_BRIDGE=m
CONFIG_NET_PKTGEN=m
# CONFIG_WIRELESS is not set
CONFIG_DEVTMPFS=y
CONFIG_DEVTMPFS_MOUNT=y
# CONFIG_FIRMWARE_IN_KERNEL is not set
CONFIG_MTD=y
CONFIG_MTD_CMDLINE_PARTS=y
CONFIG_MTD_CHAR=y
CONFIG_MTD_BLOCK=y
CONFIG_MTD_OOPS=m
CONFIG_MTD_NAND=y
CONFIG_MTD_NAND_ATMEL=y
CONFIG_MTD_UBI=y
CONFIG_MTD_UBI_DEBUG=y
CONFIG_BLK_DEV_LOOP=m
CONFIG_BLK_DEV_RAM=y
CONFIG_BLK_DEV_RAM_COUNT=4
CONFIG_BLK_DEV_RAM_SIZE=8192
CONFIG_MISC_DEVICES=y
CONFIG_ATMEL_TCLIB=y
CONFIG_ATMEL_SSC=m
CONFIG_SCSI=y
# CONFIG_SCSI_PROC_FS is not set
CONFIG_BLK_DEV_SD=y
CONFIG_SCSI_MULTI_LUN=y
CONFIG_SCSI_SCAN_ASYNC=y
# CONFIG_SCSI_LOWLEVEL is not set
CONFIG_NETDEVICES=y
CONFIG_MII=y
CONFIG_TUN=m
CONFIG_MACB=y
# CONFIG_NET_VENDOR_BROADCOM is not set
# CONFIG_NET_VENDOR_CHELSIO is not set
# CONFIG_NET_VENDOR_FARADAY is not set
# CONFIG_NET_VENDOR_INTEL is not set
# CONFIG_NET_VENDOR_MARVELL is not set
# CONFIG_NET_VENDOR_MICREL is not set
# CONFIG_NET_VENDOR_MICROCHIP is not set
# CONFIG_NET_VENDOR_NATSEMI is not set
# CONFIG_NET_VENDOR_SEEQ is not set
# CONFIG_NET_VENDOR_SMSC is not set
# CONFIG_NET_VENDOR_STMICRO is not set
CONFIG_ICPLUS_PHY=y
CONFIG_FIXED_PHY=y
CONFIG_PPP=m
CONFIG_PPP_BSDCOMP=m
CONFIG_PPP_DEFLATE=m
CONFIG_PPP_ASYNC=m
# CONFIG_WLAN is not set
# CONFIG_INPUT_MOUSEDEV_PSAUX is not set
CONFIG_INPUT_MOUSEDEV_SCREEN_X=240
CONFIG_INPUT_MOUSEDEV_SCREEN_Y=320
CONFIG_INPUT_EVDEV=y
# CONFIG_INPUT_KEYBOARD is not set
# CONFIG_INPUT_MOUSE is not set
# CONFIG_SERIO is not set
# CONFIG_LEGACY_PTYS is not set
CONFIG_SERIAL_ATMEL=y
CONFIG_SERIAL_ATMEL_CONSOLE=y
CONFIG_I2C=m
CONFIG_I2C_CHARDEV=m
CONFIG_I2C_GPIO=m
CONFIG_SPI=y
CONFIG_SPI_ATMEL=m
CONFIG_SPI_SPIDEV=m
CONFIG_GPIO_SYSFS=y
# CONFIG_HWMON is not set
CONFIG_WATCHDOG=y
CONFIG_WATCHDOG_CORE=y
CONFIG_AT91SAM9X_WATCHDOG=y
CONFIG_HID=m
CONFIG_USB_HID=m
CONFIG_USB=y
# CONFIG_USB_DEVICE_CLASS is not set
CONFIG_USB_DYNAMIC_MINORS=y
CONFIG_USB_SUSPEND=y
CONFIG_USB_OHCI_HCD=y
CONFIG_USB_ACM=m
CONFIG_USB_STORAGE=y
CONFIG_USB_GADGET=y
CONFIG_USB_AT91=y
CONFIG_USB_ETH=m
CONFIG_USB_ETH_EEM=y
CONFIG_USB_G_SERIAL=m
CONFIG_USB_G_HID=m
CONFIG_USB_GPIO_VBUS=y
CONFIG_MMC=y
CONFIG_MMC_ATMELMCI=y
CONFIG_NEW_LEDS=y
CONFIG_LEDS_CLASS=y
CONFIG_LEDS_GPIO=y
CONFIG_LEDS_TRIGGERS=y
CONFIG_LEDS_TRIGGER_TIMER=y
CONFIG_LEDS_TRIGGER_HEARTBEAT=y
CONFIG_LEDS_TRIGGER_GPIO=y
CONFIG_LEDS_TRIGGER_DEFAULT_ON=y
CONFIG_RTC_CLASS=y
# CONFIG_RTC_HCTOSYS is not set
CONFIG_RTC_DRV_AT91SAM9=y
# CONFIG_DNOTIFY is not set
CONFIG_MSDOS_FS=y
CONFIG_VFAT_FS=y
CONFIG_TMPFS=y
CONFIG_CONFIGFS_FS=y
CONFIG_UBIFS_FS=y
CONFIG_UBIFS_FS_ADVANCED_COMPR=y
# CONFIG_NETWORK_FILESYSTEMS is not set
CONFIG_NLS_CODEPAGE_437=y
CONFIG_NLS_CODEPAGE_850=y
CONFIG_NLS_ISO8859_1=y
CONFIG_PRINTK_TIME=y
CONFIG_STRIP_ASM_SYMS=y
# CONFIG_SCHED_DEBUG is not set
# CONFIG_DEBUG_PREEMPT is not set
# CONFIG_DEBUG_BUGVERBOSE is not set
# CONFIG_FTRACE is not set
# CONFIG_ARM_UNWIND is not set
CONFIG_KEYS=y
# CONFIG_CRYPTO_MANAGER_DISABLE_TESTS is not set
CONFIG_CRYPTO_CCM=y
CONFIG_CRYPTO_GCM=y
CONFIG_CRYPTO_CBC=y
CONFIG_CRYPTO_ECB=y
CONFIG_CRYPTO_MD5=y
CONFIG_CRYPTO_SHA1=y
CONFIG_CRYPTO_SHA256=y
CONFIG_CRYPTO_SHA512=y
CONFIG_CRYPTO_ARC4=y
CONFIG_CRYPTO_DES=y
CONFIG_CRYPTO_ANSI_CPRNG=y
CONFIG_CRYPTO_USER_API_HASH=y
CONFIG_CRYPTO_USER_API_SKCIPHER=y
# CONFIG_CRYPTO_HW is not set
CONFIG_CRC_ITU_T=m
CONFIG_AVERAGE=y
```

## configs/sterling_supplicant-arm_defconfig
```kconfig
BR2_arm=y
BR2_WGET="wget --passive-ftp -nd"
BR2_DL_DIR="$(HOME)/.br2_dl_dir"
BR2_CCACHE=y
BR2_CCACHE_DIR="$(BR2_DL_DIR)/.buildroot-ccache"
BR2_PACKAGE_OVERRIDE_FILE="$(BR2_EXTERNAL_LRD_SOM_PATH)/board/supplicant/sterling_supplicant-local.mk"
BR2_PER_PACKAGE_DIRECTORIES=y
BR2_TOOLCHAIN_EXTERNAL=y
BR2_TOOLCHAIN_EXTERNAL_LAIRD_COMPONENT=y
BR2_ROOTFS_SKELETON_CUSTOM=y
BR2_ROOTFS_SKELETON_CUSTOM_PATH="$(BR2_EXTERNAL_LRD_SOM_PATH)/board/skeleton-empty"
BR2_INIT_NONE=y
BR2_ROOTFS_DEVICE_TABLE=""
BR2_ROOTFS_POST_IMAGE_SCRIPT="$(BR2_EXTERNAL_LRD_SOM_PATH)/board/supplicant/post_image.sh"
# BR2_PACKAGE_BUSYBOX is not set
BR2_PACKAGE_LIBOPENSSL_1_0_2=y
BR2_PACKAGE_WPA_SUPPLICANT=y
BR2_PACKAGE_WPA_SUPPLICANT_AP_SUPPORT=y
BR2_PACKAGE_WPA_SUPPLICANT_AUTOSCAN=y
BR2_PACKAGE_WPA_SUPPLICANT_EAP=y
BR2_PACKAGE_WPA_SUPPLICANT_DEBUG_SYSLOG=y
BR2_PACKAGE_WPA_SUPPLICANT_WPA3=y
BR2_PACKAGE_WPA_SUPPLICANT_CLI=y
BR2_PACKAGE_WPA_SUPPLICANT_WPA_CLIENT_SO=y
BR2_PACKAGE_WPA_SUPPLICANT_PASSPHRASE=y
BR2_PACKAGE_WPA_SUPPLICANT_DBUS=y
BR2_PACKAGE_WPA_SUPPLICANT_DBUS_INTROSPECTION=y
# BR2_TARGET_ROOTFS_TAR is not set
```

## package/lrd-br/backports-test/Config.in.host
```kconfig
config BR2_PACKAGE_HOST_BACKPORTS_TEST
	bool "host backports regression test"
	select BR2_PACKAGE_HOST_ZSTD
```

## package/lrd-br/backports/Config.in.host
```kconfig
config BR2_PACKAGE_HOST_BACKPORTS
	bool "host backports"
	help
	   To generate the tarball
```

## package/lrd-br/composer/Config.in.host
```kconfig
config BR2_PACKAGE_HOST_COMPOSER
	bool "host-composer"
	help
	  This package contains the tool to download and manage
	  PHP projects.

	  https://getcomposer.org/
```

## package/lrd-br/firewalld/Config.in
```kconfig
config BR2_PACKAGE_FIREWALLD
	bool "firewalld"
	depends on BR2_USE_MMU # ebtables, gobject-introspection
	depends on BR2_USE_WCHAR # dbus-python, gettext
	depends on BR2_PACKAGE_GOBJECT_INTROSPECTION_ARCH_SUPPORTS # gobject-introspection
	depends on BR2_TOOLCHAIN_GCC_AT_LEAST_4_9 # gobject-introspection
	depends on BR2_HOST_GCC_AT_LEAST_7 # gobject-introspection -> host-qemu
	depends on BR2_TOOLCHAIN_HAS_THREADS # dbus-python
	depends on BR2_TOOLCHAIN_USES_GLIBC # gobject-introspection
	depends on BR2_TOOLCHAIN_HEADERS_AT_LEAST_3_12 # nftables
	select BR2_PACKAGE_NFTABLES
	select BR2_PACKAGE_JANSSON # nftables
	select BR2_PACKAGE_DBUS # dbus-python
	select BR2_PACKAGE_PYTHON3
	select BR2_PACKAGE_PYTHON3_PYEXPAT # runtime
	select BR2_PACKAGE_DBUS_PYTHON
	select BR2_PACKAGE_GETTEXT
	select BR2_PACKAGE_PYTHON_GOBJECT
	help
	  Firewalld provides a dynamically managed firewall with
	  support for network or firewall zones to define the trust
	  level of network connections or interfaces. It has support
	  for IPv4, IPv6 firewall settings and for ethernet bridges and
	  a separation of runtime and permanent configuration options.
	  It also provides an interface for services or applications to
	  add ip*tables and ebtables rules directly.

	  https://github.com/firewalld/firewalld

if BR2_PACKAGE_FIREWALLD

config BR2_PACKAGE_FIREWALLD_DEFAULT_ZONE_VALUE
	string "Default zone name"
	default "trusted"

choice
	prompt "Firewall type"
	default BR2_PACKAGE_FIREWALLD_IPTABLES
	help
	  Select which firewall type is used.

config BR2_PACKAGE_FIREWALLD_IPTABLES
	bool "iptables"
	select BR2_PACKAGE_IPTABLES
	help
	  Use iptables as firewall.

config BR2_PACKAGE_FIREWALLD_NFTABLES
	bool "nftables"
	help
	  Use nftables as firewall.
endchoice

config BR2_PACKAGE_FIREWALLD_DEFAULT_BACKEND_VALUE
	string
	default "iptables" if BR2_PACKAGE_FIREWALLD_IPTABLES
	default "nftables" if BR2_PACKAGE_FIREWALLD_NFTABLES

endif # BR2_PACKAGE_FIREWALLD

comment "firewalld needs a glibc toolchain w/ wchar, threads, gcc >= 4.9"
	depends on BR2_USE_MMU || !BR2_USE_WCHAR
	depends on BR2_PACKAGE_DBUS && BR2_PACKAGE_HOST_QEMU_ARCH_SUPPORTS
	depends on !BR2_TOOLCHAIN_USES_GLIBC || \
		!BR2_TOOLCHAIN_HAS_THREADS || !BR2_TOOLCHAIN_GCC_AT_LEAST_4_9
```

## package/lrd-br/lrd-brcm-patchram-plus/Config.in
```kconfig
config BR2_PACKAGE_PROVIDES_BRCM_PATCHRAM_PLUS
	depends on BR2_PACKAGE_BLUEZ5_UTILS || BR2_PACKAGE_BLUEZ_UTILS
	default "lrd-brcm-patchram-plus" if BR2_PACKAGE_LRD_BRCM_PATCHRAM_PLUS
	help
	  Broadcom utility to flash Bluetooth firmwares, extended with
	  per-device Low Power Mode configuration.
```

## package/lrd-br/node-ssl-shim/Config.in
```kconfig
config BR2_PACKAGE_NODE_SSL_SHIM
	bool "node ssl shim"
	depends on BR2_PACKAGE_OPENSSL
	help
	  Build Node.js OpenSSL shim for use with
	  building Node.js

	  https://github.com/sclorg/node-ssl-shim
```

## package/lrd-br/python-cherrypy/Config.in
```kconfig
config BR2_PACKAGE_PYTHON_CHERRYPY
	bool "python-cherrypy"
	select BR2_PACKAGE_PYTHON_CHEROOT # runtime
	select BR2_PACKAGE_PYTHON_PORTEND # runtime
	select BR2_PACKAGE_PYTHON_MORE_ITERTOOLS # runtime
	select BR2_PACKAGE_PYTHON_ZC_LOCKFILE # runtime
	help
	  A minimalist web framework

	  http://www.cherrypy.org
```

## package/lrd-br/python-dtlssocket/Config.in
```kconfig
config BR2_PACKAGE_PYTHON_DTLSSOCKET
	bool "python-dtlssocket"
	depends on BR2_PACKAGE_HOST_PYTHON_CYTHON
	help
	  https://git.fslab.de/jkonra2m/tinydtls-cython
```

## package/lrd-br/wifi-test-suite/Config.in
```kconfig
config BR2_PACKAGE_WIFI_TEST_SUITE
	bool "wifi_test_suite"
	depends on BR2_TOOLCHAIN_HAS_NATIVE_RPC || BR2_TOOLCHAIN_HAS_THREADS # libtirpc
	select BR2_PACKAGE_LIBTIRPC if !BR2_TOOLCHAIN_HAS_NATIVE_RPC
	help
	   The Wi-Fi Test Suit Linux Control Agent is a program
	   by the Wi-fi alliance that enables certification of
	   programs and devices.
	   https://github.com/Wi-FiTestSuite/Wi-FiTestSuite-Linux-DUT/
```

## package/lrd/demo-gui/Config.in
```kconfig
config BR2_PACKAGE_DEMO_GUI
	bool "lrd gui demo"
	depends on BR2_PACKAGE_QT5BASE
	depends on BR2_PACKAGE_LIBDRM
	depends on BR2_PACKAGE_LIBPLANES
	depends on BR2_PACKAGE_LRD_NETWORK_MANAGER
	help
		lrd gui demo applications
```

## package/lrd/eventmon/Config.in
```kconfig
config BR2_PACKAGE_EVENTMON
	bool "eventmon"
	select BR2_PACKAGE_LIBNL
	depends on BR2_PACKAGE_SDCSDK || BR2_PACKAGE_SUMMIT_SUPPLICANT_BINARIES
	help
	  Laird Event Monitor
```

## package/lrd/fipscheck/Config.in
```kconfig
config BR2_PACKAGE_FIPSCHECK
	bool "fipscheck"
	select BR2_PACKAGE_OPENSSL
	default y if BR2_LRD_FIPS_RADIO
	help
	  FIPS Integrity Checker

config BR2_PACKAGE_HOST_FIPSCHECK
	bool "host fipscheck"
	default y if BR2_LRD_FIPS_RADIO
	help
	  FIPS Integrity Checker
```

## package/lrd/igconfd/Config.in
```kconfig
config BR2_PACKAGE_IGCONFD
	bool "igconfd"
	depends on BR2_PACKAGE_BLUEZ5_UTILS
	depends on BR2_PACKAGE_PYTHON3
	select BR2_PACKAGE_GOBJECT_INTROSPECTION
	select BR2_PACKAGE_PYTHON_GOBJECT
	select BR2_PACKAGE_PYTHON_SYSTEMD
	select BR2_PACKAGE_DBUS_PYTHON
	help
	  Laird Industrial Gateway Configuration Service
```

## package/lrd/igupd/Config.in
```kconfig
config BR2_PACKAGE_IGUPD
	bool "igupd"
	select BR2_PACKAGE_PYTHON3
	select BR2_PACKAGE_GOBJECT_INTROSPECTION
	select BR2_PACKAGE_PYTHON_GOBJECT
	select BR2_PACKAGE_PYTHON_PSUTIL
	select BR2_PACKAGE_PYTHON_PYUDEV
	select BR2_PACKAGE_LRD_SWUPDATE_CLIENT
	help
	  Laird Industrial Gateway Update Service
```

## package/lrd/laird_openssl_fips-binaries/Config.in
```kconfig
if BR2_PACKAGE_LAIRD_OPENSSL_FIPS_BINARIES

config BR2_PACKAGE_LAIRD_OPENSSL_3_0_FIPS_BINARIES
	bool "Use Laird openssl-3.0 fips binaries"
	help
		This is Laird openssl FIPS binaries (3.0.x).

config BR2_PACKAGE_LAIRD_OPENSSL_FIPS_BINARIES_VERSION_VALUE
	string
	default "0.10.0.0" if BR2_PACKAGE_LAIRD_OPENSSL_3_0_FIPS_BINARIES
	default "7.0.0.713"

config BR2_PACKAGE_LIBOPENSSL_BIN
	bool "openssl binary"
	help
	  Install the openssl binary and the associated helper scripts
	  to the target file system. This is a command line tool for
	  doing various cryptographic stuff.

endif # BR2_PACKAGE_LAIRD_OPENSSL_FIPS_BINARIES
```

## package/lrd/lrd-bt-utils/Config.in
```kconfig
config BR2_PACKAGE_LRD_BT_UTILS
	bool "lrd-bt-utils"
	help
	  Utilities to support bluetooth device programming and operations
	depends on BR2_PACKAGE_PYTHON || BR2_PACKAGE_PYTHON3
```

## package/lrd/lrd-encrypted-storage-toolkit/Config.in
```kconfig
config BR2_PACKAGE_LRD_ENCRYPTED_STORAGE_TOOLKIT
	bool "lrd encrypted storage toolkit"
	select BR2_PACKAGE_KEYUTILS
	select BR2_PACKAGE_FSCRYPTCTL
	select BR2_PACKAGE_HOST_FSCRYPTCTL
	select BR2_TARGET_UBOOT_NEEDS_OPENSSL
	help
	Toolkit for implementing Laird's U-Boot encryption
	with Linux per directory encryption. This is part of
	Laird's Chain of Trust architecture.
```

## package/lrd/lrd-fips-utils/Config.in
```kconfig
config BR2_PACKAGE_LRD_FIPS_UTILS
	bool "lrd fips utils"
	help
	  Laird FIPS utility script
```
