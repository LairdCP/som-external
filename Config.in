## package/lrd/lrd-legacy/Config.in
```kconfig
config BR2_PACKAGE_LRD_LEGACY
	bool "lrd-legacy"
	select BR2_PACKAGE_DHCPCD
	select BR2_PACKAGE_OPENRESOLV
	select BR2_PACKAGE_EVENTMON
	help
	  Laird legacy software
```

## package/lrd/lrd-radio/adaptive_bt/Config.in
```kconfig
config BR2_PACKAGE_ADAPTIVE_BT
	bool "Adaptive Bluetooth Power Service"
	depends on BR2_PACKAGE_BLUEZ5_UTILS || BR2_PACKAGE_BLUEZ_UTILS
	select BR2_PACKAGE_LIBNL
	help
		Laird Connectivity 60 Series Radio's Adaptive Bluetooth Power Control
```

## package/lrd/lrd-radio/reg45n-binaries/Config.in
```kconfig
config BR2_PACKAGE_REG45N_BINARIES
	bool "45 series regulatory tools"
	default n
	select BR2_PACKAGE_LIBEDIT
	help
	  This package installs 45 series regulatory tools.
```

## package/lrd/lrd-radio/reg50n-binaries/Config.in
```kconfig
config BR2_PACKAGE_REG50N_BINARIES
	bool "50 series regulatory tools"
	default n
	select BR2_PACKAGE_LIBEDIT
	help
	  This package installs 50 series regulatory tools.
```
