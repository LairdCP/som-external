## package/lrd/lrd-radio/som60-firmware-binaries/Config.in
```kconfig
config BR2_PACKAGE_SOM60_FIRMWARE_BINARIES
	bool "SOM60 Firmware Installer"
	select BR2_PACKAGE_LAIRD_FIRMWARE if BR2_LRD_DEVEL_BUILD="y"
	select BR2_PACKAGE_LAIRD_FIRMWARE_LRDMWL_SOM60 if BR2_LRD_DEVEL_BUILD="y"
	select BR2_PACKAGE_LRD_WIRELESS_REGDB if BR2_LRD_DEVEL_BUILD="y"
	help
      Extracts the Laird som60 wireless firmware binaries from an firmware release and install them on the target.

if BR2_PACKAGE_SOM60_FIRMWARE_BINARIES
config BR2_PACKAGE_SOM60_ST_SDIO_UART_FIRMWARE_BINARIES
	bool "SOM60 Sterling Firmware Installer"
	help
      Extracts the Laird Sterling SDIO/UART wireless firmware binary from a firmware release and installs it on the target in addition to the normal SOM60 firmware.
endif
```

## package/lrd/lrd-radio/summit-supplicant-binaries/Config.in
```kconfig
config BR2_PACKAGE_SUMMIT_SUPPLICANT_BINARIES
	bool "Summit Supplicant Binaries Installer"
	select BR2_PACKAGE_LIBNL
	select BR2_PACKAGE_DBUS if !BR2_PACKAGE_LRD_LEGACY
	select BR2_PACKAGE_OPENSSL
	select BR2_PACKAGE_LIBEDIT if BR2_PACKAGE_LRD_LEGACY
	select BR2_PACKAGE_SDCSUPP if BR2_LRD_DEVEL_BUILD
	select BR2_PACKAGE_SDCSUPP_WPA_CLI if BR2_LRD_DEVEL_BUILD
	select BR2_PACKAGE_SDCSUPP_LEGACY if BR2_LRD_DEVEL_BUILD && BR2_PACKAGE_LRD_LEGACY
	select BR2_PACKAGE_SDCSDK if BR2_LRD_DEVEL_BUILD && BR2_PACKAGE_LRD_LEGACY
	select BR2_PACKAGE_SDCCLI if BR2_LRD_DEVEL_BUILD && BR2_PACKAGE_LRD_LEGACY
	help
	  Extracts sdcsupp, wpa_cli binaries from summit supplicant release and install them on the target.

config BR2_PACKAGE_SUMMIT_SUPPLICANT_BINARIES_SUFFIX
	string
	depends on BR2_PACKAGE_SUMMIT_SUPPLICANT_BINARIES
	default "_legacy_openssl_1_0_2" if BR2_PACKAGE_LRD_LEGACY && BR2_PACKAGE_LIBOPENSSL_1_0_2
	default "_legacy_openssl_3_0" if BR2_PACKAGE_LRD_LEGACY && BR2_PACKAGE_LIBOPENSSL_3_0
	default "_legacy_fips" if BR2_PACKAGE_LRD_LEGACY && BR2_PACKAGE_LAIRD_OPENSSL_FIPS_BINARIES
	default "_legacy" if BR2_PACKAGE_LRD_LEGACY
	default "_openssl_1_0_2" if BR2_PACKAGE_LIBOPENSSL_1_0_2
	default "_openssl_3_0" if BR2_PACKAGE_LIBOPENSSL_3_0
	default "_fips" if BR2_PACKAGE_LAIRD_OPENSSL_FIPS_BINARIES
```

## package/lrd/lrd-swupdate-client/Config.in
```kconfig
config BR2_PACKAGE_LRD_SWUPDATE_CLIENT
	bool "Swupdate client API python binding"
	select BR2_PACKAGE_SWUPDATE
	help
	  Wrapped API for swupdate client.
```

## package/lrd/lwm2m-python-client/Config.in
```kconfig
config BR2_PACKAGE_LWM2M_PYTHON_CLIENT
	bool "lwm2m-python-client"
	depends on BR2_PACKAGE_PYTHON3
	select BR2_PACKAGE_GOBJECT_INTROSPECTION
	select BR2_PACKAGE_PYTHON3_GOBJECT
	select BR2_PACKAGE_PYTHON3_ZLIB
	select BR2_PACKAGE_PYTHON_SYSTEMD
	select BR2_PACKAGE_DBUS_PYTHON
	select BR2_PACKAGE_PYTHON_REQUESTS
	select BR2_PACKAGE_PYTHON_AIOCOAP
	select BR2_PACKAGE_PYTHON_DTLSSOCKET
	help
	  LwM2M Client
```

## package/lrd/php_sdk/Config.in
```kconfig
config BR2_PACKAGE_PHP_SDK
	bool "LAIRD PHP SDK"
	depends on BR2_PACKAGE_SDCSDK || BR2_PACKAGE_SUMMIT_SUPPLICANT_BINARIES
	select BR2_PACKAGE_PHP
	select BR2_PACKAGE_PHP_EXT_JSON
	help
	  Laird SDK PHP library interface

if BR2_PACKAGE_PHP_SDK

config BR2_PACKAGE_PHP_SDK_TEST
	bool "Test PHP script"
	help
	  Install test PHP script to webserver on target.

endif
```
